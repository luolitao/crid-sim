## sdkconfig.defaults
```kconfig
CONFIG_FREERTOS_UNICORE=y

CONFIG_BT_ENABLED=n
CONFIG_ESP_MAC_IGNORE_MAC_CRC_ERROR=y
CONFIG_ESP_MAC_USE_CUSTOM_MAC_AS_BASE_MAC=y

CONFIG_ESPTOOLPY_FLASHSIZE_4MB=y
CONFIG_ESPTOOLPY_FLASHSIZE="4MB"
CONFIG_PARTITION_TABLE_TWO_OTA_LARGE=y

CONFIG_FREERTOS_HZ=100
```
